## configs/rpi_4_aosp_user_defconfig
```kconfig
#include <configs/rpi_4_aosp_defconfig>

#
# No shell
#
CONFIG_BOOTDELAY=-2
CONFIG_BOOTCOMMAND="bootandroid; reset"

#
# No env loading
#
# CONFIG_ENV_IS_IN_FAT is not set
CONFIG_ENV_IS_NOWHERE=y
# CONFIG_CMD_SAVEENV is not set
```

## configs/rpi_5_aosp_user_defconfig
```kconfig
#include <configs/rpi_5_aosp_defconfig>

#
# No shell
#
CONFIG_BOOTDELAY=-2
CONFIG_BOOTCOMMAND="bootandroid; reset"

#
# No env loading
#
# CONFIG_ENV_IS_IN_FAT is not set
CONFIG_ENV_IS_NOWHERE=y
# CONFIG_CMD_SAVEENV is not set
```

## configs/rpi_aosp_release_defconfig
```kconfig
#include <configs/rpi_aosp_debug_defconfig>

#
# No shell
#
CONFIG_BOOTDELAY=-2
CONFIG_BOOTCOMMAND="bootandroid; reset"

#
# No env loading
#
# CONFIG_ENV_IS_IN_FAT is not set
CONFIG_ENV_IS_NOWHERE=y
# CONFIG_CMD_SAVEENV is not set
```
